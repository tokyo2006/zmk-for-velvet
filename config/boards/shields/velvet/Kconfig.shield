## config/boards/shields/velvet/Kconfig.shield
```kconfig
# Copyright (c) 2020 The ZMK Contributors
# SPDX-License-Identifier: MIT

config SHIELD_VELVET_CENTRAL_DONGLE
    def_bool $(shields_list_contains,velvet_central_dongle)

config SHIELD_VELVET_CENTRAL_LEFT
    def_bool $(shields_list_contains,velvet_central_left)
    
config SHIELD_VELVET_PERIPHERAL_LEFT
    def_bool $(shields_list_contains,velvet_peripheral_left)

config SHIELD_VELVET_PERIPHERAL_RIGHT
    def_bool $(shields_list_contains,velvet_peripheral_right)
```
