/*
 * Copyright (c) 2020 The ZMK Contributors
 *
 * SPDX-License-Identifier: MIT
 */

#include "velvet.dtsi"

&default_transform {
	col-offset = <6>;
};

&kscan0 {
    col-gpios
        = <&gpio0 8  GPIO_ACTIVE_HIGH>
        , <&gpio0 17  GPIO_ACTIVE_HIGH>
        , <&gpio0 20  GPIO_ACTIVE_HIGH>
        , <&gpio0 22  GPIO_ACTIVE_HIGH>
        , <&gpio0 24  GPIO_ACTIVE_HIGH>
        , <&gpio1 0  GPIO_ACTIVE_HIGH>
        ;
};
