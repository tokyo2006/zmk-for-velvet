/*
 * Copyright (c) 2020 The ZMK Contributors
 *
 * SPDX-License-Identifier: MIT
 */

#include "velvet.dtsi"

&default_transform {
	col-offset = <6>;
};

&kscan0 {
    compatible = "zmk,kscan-gpio-matrix";
    row-gpios
	= <&gpio1 11 (GPIO_ACTIVE_HIGH | GPIO_PULL_DOWN)>
	, <&gpio0 10 (GPIO_ACTIVE_HIGH | GPIO_PULL_DOWN)>
	, <&gpio0 9  (GPIO_ACTIVE_HIGH | GPIO_PULL_DOWN)>
	, <&gpio0 6 (GPIO_ACTIVE_HIGH | GPIO_PULL_DOWN)>
	;
    col-gpios
        = <&gpio1 0  GPIO_ACTIVE_HIGH>
        , <&gpio0 24  GPIO_ACTIVE_HIGH>
        , <&gpio0 22  GPIO_ACTIVE_HIGH>
        , <&gpio0 20  GPIO_ACTIVE_HIGH>
        , <&gpio0 17  GPIO_ACTIVE_HIGH>
        , <&gpio0 8  GPIO_ACTIVE_HIGH>
        ;
};
